#include <SPI.h>
#include <TimerOne.h>

const int DAC_SS_pin = 8;
const int in_pin = 2;
#define SAMPLE_RATE 22050

// 10000 Hz
PROGMEM const prog_uchar B[] = {111, 104, 107, 105, 106, 105, 105, 105, 106, 107, 106, 107, 108,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 116,};
const int B_size = 10991;
// 22050 Hz
//PROGMEM const prog_uchar B[] = {114, 104, 106, 104, 107, 106, 111, 115, 115, 117, 116, 117, 118,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 116, 112};
//const int B_size = 4984;

typedef enum state_t{
  STATE_IDLE,
  STATE_PLAY,
  STATE_PLAYING
} state_t;

volatile state_t state = STATE_IDLE;
volatile float volume;

void setup(){
  pinMode(DAC_SS_pin, OUTPUT);
  pinMode(in_pin, INPUT);
  SPI.begin(); 
  SPI.setDataMode(SPI_MODE1);
  SPI.setClockDivider(SPI_CLOCK_DIV2); 
  Serial.begin(115200);
  
  Timer1.initialize(1000000/SAMPLE_RATE);
  Timer1.attachInterrupt(timer_int);
}


void setDAC(byte b){
  byte a1 = (b&0xf0) >> 4;
  byte a2 = (b&0x0f) << 4;
  digitalWrite(DAC_SS_pin, LOW);
  SPI.transfer(a1);
  SPI.transfer(a2);
  digitalWrite(DAC_SS_pin, HIGH);
}

void loop(){
  while(1){
    //Serial.println(analogRead(in_pin));
    //delay(200);
    //return;
    if(analogRead(in_pin) > 920 && state == STATE_IDLE){
      Serial.println("Dzien");
      float scale = random(1000)/1000.0;
      scale = 2.0*scale - 1.0;
      scale = pow(2.0, scale);
      Timer1.setPeriod(scale*1000000.0/SAMPLE_RATE);
      volume = random(2000)/3000.0 + 1.0/3.0;
      state = STATE_PLAY;
      while(analogRead(in_pin) > 850);
      Serial.println("dobry.");
      delay(1000);
    }
  }
}

byte getsample(int n){
  signed char c = pgm_read_byte_near(B + n++);
  c -= 128;
  c *= volume;
  c += 128;
  return c;
}

void timer_int(){
  static int n;
  if(state == STATE_IDLE) {
    setDAC(128);
  }
  else if(state == STATE_PLAY){
    n = 0;
    setDAC(getsample(n++));
    state = STATE_PLAYING;
  }else if(state == STATE_PLAYING){
    setDAC(getsample(n++));
    if(n >= B_size){
      state = STATE_IDLE; 
    }
  }
}
